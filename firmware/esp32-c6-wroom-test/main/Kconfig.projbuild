## firmware/esp32-c6-wroom-test/main/Kconfig.projbuild
```kconfig
menu "ESP32-C6 MCU test"

    config KB_LED_GPIO
        int "Status LED GPIO"
        default 7
        help
            Key Box D11 is on IO7 (active high).

    config KB_BUTTON_GPIO
        int "Service button GPIO"
        default 9
        help
            Key Box SW2 SERVICE / BOOT on IO9 (active low). Hold 5 s to clear Wi-Fi and re-provision.

    config KB_PROV_POP
        string "BLE provisioning proof of possession"
        default "esp32c6"

endmenu
```
